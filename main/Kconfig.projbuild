## main/Kconfig.projbuild
```kconfig
menu "OV7670 Webcam"

    config APP_WIFI_SSID
        string "WiFi SSID (de trong = chay SoftAP)"
        default ""

    config APP_WIFI_PASSWORD
        string "WiFi password"
        default ""

    config APP_WIFI_MAX_RETRY
        int "So lan thu ket noi WiFi truoc khi chuyen sang SoftAP"
        default 5

    config APP_AP_SSID
        string "SoftAP SSID"
        default "OV7670-CAM"

    config APP_AP_PASSWORD
        string "SoftAP password (>= 8 ky tu)"
        default "12345678"

    config APP_XCLK_MHZ
        int "XCLK frequency (MHz)"
        range 5 20
        default 10
        help
            10 MHz on dinh hon voi day jump. Co the tang len 20 neu day ngan.

    config APP_JPEG_QUALITY
        int "JPEG quality (5..63, so nho = chat luong cao)"
        range 5 63
        default 12

    choice APP_FRAME_SIZE
        prompt "Frame size"
        default APP_FRAME_QVGA

        config APP_FRAME_QQVGA
            bool "QQVGA 160x120"
        config APP_FRAME_QVGA
            bool "QVGA 320x240"
        config APP_FRAME_VGA
            bool "VGA 640x480 (can PSRAM)"
    endchoice

    choice APP_PIXFMT
        prompt "Pixel format tu cam bien"
        default APP_PIXFMT_RGB565

        config APP_PIXFMT_RGB565
            bool "RGB565"
        config APP_PIXFMT_YUV422
            bool "YUV422 (thu cai nay neu mau sai/ngoai y muon)"
    endchoice

endmenu
```

## sdkconfig.defaults
```kconfig
# Flash / partition
CONFIG_ESPTOOLPY_FLASHSIZE_4MB=y
CONFIG_PARTITION_TABLE_SINGLE_APP_LARGE=y
CONFIG_SPIRAM=y
CONFIG_SPIRAM_MODE_OCT=y
CONFIG_SPIRAM_SPEED_80M=y
CONFIG_SPIRAM_IGNORE_NOTFOUND=y
CONFIG_SPIRAM_USE_MALLOC=y

# Camera driver
CONFIG_OV7670_SUPPORT=y

# Network / system
CONFIG_LWIP_MAX_SOCKETS=16
CONFIG_ESP_MAIN_TASK_STACK_SIZE=8192
CONFIG_FREERTOS_HZ=1000
# Giam loi DMA/PSRAM tren ESP32-S3
CONFIG_ESP32S3_DATA_CACHE_64KB=y
CONFIG_ESP32S3_DATA_CACHE_LINE_64B=y
CONFIG_ESP_DEFAULT_CPU_FREQ_MHZ_240=y


# Toc do: build -O2, camera DMA thang vao PSRAM (khong memcpy), task camera tach khoi core WiFi
CONFIG_COMPILER_OPTIMIZATION_PERF=y
CONFIG_CAMERA_PSRAM_DMA=y
CONFIG_CAMERA_CORE1=y
CONFIG_LWIP_TCP_SND_BUF_DEFAULT=23040
CONFIG_LWIP_TCP_WND_DEFAULT=23040
```
